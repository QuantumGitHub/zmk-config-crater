## config/boards/shields/crater/Kconfig.defconfig
```kconfig
if SHIELD_CRATER_LEFT

config ZMK_KEYBOARD_NAME
    default "Crater"

config ZMK_SPLIT_ROLE_CENTRAL
    default y

endif

if SHIELD_CRATER_LEFT || SHIELD_CRATER_RIGHT

    config ZMK_SPLIT
        default y

endif
```

## config/boards/shields/crater/Kconfig.shield
```kconfig
config SHIELD_CRATER_LEFT
    def_bool $(shields_list_contains,crater_left)

config SHIELD_CRATER_RIGHT
    def_bool $(shields_list_contains,crater_right)
```
